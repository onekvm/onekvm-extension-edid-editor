## oe-recipes/conf/layer.conf
```bitbake
BBPATH .= ":${LAYERDIR}"
BBFILES += "${LAYERDIR}/recipes-*/*/*.bb ${LAYERDIR}/recipes-*/*/*.bbappend"
BBFILE_COLLECTIONS += "onekvm-extension-edid-editor"
BBFILE_PATTERN_onekvm-extension-edid-editor := "^${LAYERDIR}/"
BBFILE_PRIORITY_onekvm-extension-edid-editor = "8"
LAYERDEPENDS_onekvm-extension-edid-editor = "core onekvm"
LAYERSERIES_COMPAT_onekvm-extension-edid-editor = "wrynose"
```
